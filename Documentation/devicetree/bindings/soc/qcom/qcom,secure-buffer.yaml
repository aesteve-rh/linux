## Documentation/devicetree/bindings/soc/qcom/qcom,secure-buffer.yaml
```yaml
# SPDX-License-Identifier: (GPL-2.0-only OR BSD-2-Clause)
%YAML 1.2
---
$id: http://devicetree.org/schemas/soc/qcom/qcom,secure-buffer.yaml#
$schema: http://devicetree.org/meta-schemas/core.yaml#

title: Qualcomm secure buffer helper

maintainers:
  - Bjorn Andersson <andersson@kernel.org>
  - Konrad Dybcio <konradybcio@kernel.org>

description:
  Platform device used by the qcom secure buffer helper to DMA-map
  hypervisor memory-assign descriptors. Clients use hyp_assign_table()
  to retarget buffer ownership toward TrustZone or other VMs.

properties:
  compatible:
    const: qcom,secure-buffer

  qcom,vmid-cp-camera-preview-ro:
    type: boolean
    description:
      Restrict VMID_CP_CAMERA_PREVIEW mappings to read-only permissions.

required:
  - compatible

additionalProperties: false

examples:
  - |
    secure-buffer {
        compatible = "qcom,secure-buffer";
    };
```
